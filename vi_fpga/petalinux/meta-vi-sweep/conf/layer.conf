## vi_fpga/petalinux/meta-vi-sweep/conf/layer.conf
```bitbake
# meta-vi-sweep layer configuration
BBPATH .= ":${LAYERDIR}"
BBFILES += "${LAYERDIR}/recipes-*/*/*.bb ${LAYERDIR}/recipes-*/*/*.bbappend"
BBFILE_COLLECTIONS += "vi-sweep"
BBFILE_PATTERN_vi-sweep = "^${LAYERDIR}/"
BBFILE_PRIORITY_vi-sweep = "10"

LAYERDEPENDS_vi-sweep = "core"
LAYERSERIES_COMPAT_vi-sweep = "scarthgap styhead"
```
